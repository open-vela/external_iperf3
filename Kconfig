## Kconfig
```kconfig
#
# For a description of the syntax of this configuration file,
# see the file kconfig-language.txt in the NuttX tools repository.
#

config TOOLS_IPERF3
	tristate "iperf3"
	select DEV_URANDOM
	select FS_RAMMAP
	select LIBC_FLOATINGPOINT
	default n
	---help---
		Enable iperf3 tool.

if TOOLS_IPERF3

config TOOLS_IPERF3_PRIORITY
	int "iperf3 task priority"
	default 100
	---help---
		The priority for iperf3 task.

config TOOLS_IPERF3_STACKSIZE
	int "iperf3 task stack size"
	default 4096
	---help---
		The stack size allocated for the iperf3 task.

endif # TOOLS_IPERF
```
